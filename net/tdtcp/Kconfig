## net/tdtcp/Kconfig
```kconfig
config TDTCP
	bool "TDTCP: Time-division TCP"
	depends on INET
	select SKB_EXTENSIONS
	default y
	help
	  Time-division TCP (TDTCP) connections can adapt to rapidly changing
	  network conditions such as bandwidth and latency, while achieving a
	  better performance than normal TCP.

config TDTCP_HANDSHAKE
	bool "TDTCP handshake allowed"
	depends on TDTCP
	default y
	help
	  Controls whether the local side of a new socket is TDTCP enabled. If
	  set to 'y', TDTCP handshake is allowed on the local side.

config TDTCP_ICMP_TDN_SW
	bool "React to ICMP TDN switching"
	depends on TDTCP
	default y
	help
	  If 'y', enables reaction to ICMP packets that switch the TDN.

config TDTCP_DEV
	bool "TDTCP dev features"
	depends on TDTCP
	default y
	help
	  Decides whether the dev features of TDTCP are enabled.

config PER_SOCK_TDN
	bool "Per-socket TDN ID"
	depends on TDTCP
	default y
	help
	  Each socket has its own current TDN ID associated when enabled.
```
